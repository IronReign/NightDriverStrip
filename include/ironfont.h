#include "globals.h" 

//Mahesh made this 4x6 font in fontstruct
const uint8_t IronFontBitmaps[] PROGMEM = {
0x69,0x99,0x96, // 0
0xe2,0x22,0x2f, // 1
0xf1,0xf8,0x8f, // 2
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0x00,0x00,0x00  // space - default unsupported glyph
};

int rowsPerChar = 6;
int columnsPerChar = 4;

int bitsPerChar = rowsPerChar*columnsPerChar; 
int bytesPerChar = bitsPerChar/8;
int rowsPerByte = 2; 

int getPixels(char c){
    int pixies;
    int i;

    //convert from the ascii ordinals baked into C to the encoding Mahesh provided
    //todo - would be better to re-encode array into ascii format
    if (isdigit(c)) i = c - 48;
    else i = c-55;
    //i=0; //test - force to a specific char in the font array

    pixies = (IronFontBitmaps[i*bytesPerChar]<<16) +
            (IronFontBitmaps[i*bytesPerChar+1]<<8) +
            (IronFontBitmaps[i*bytesPerChar+2]);
    
    return pixies;

}

bool getPix(char c, int y, int x)
{
    if (isalpha(c)) c = toupper(c);
    else if(isdigit(c)) ;//do nothing
    else c='['; //force everyting else to read as the last glyph
    int pixies = getPixels(c);
    //pixies =  5592405; //test - 24 bits of 01 repeated
    //pixies = 6922137; //test - A
    int n=y*columnsPerChar+x;

    /* Right shift num, n times and perform bitwise AND with 1 */
    bool bitStatus = (pixies >> (23-n)) & 1;
    
    //bitStatus=(x==y || x==3); //test with diagonal line

    return bitStatus;
}